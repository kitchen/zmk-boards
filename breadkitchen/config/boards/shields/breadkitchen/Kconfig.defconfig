## breadkitchen/config/boards/shields/breadkitchen/Kconfig.defconfig
```kconfig
if SHIELD_BREADKITCHEN

config ZMK_KEYBOARD_NAME
       default "breadkitchen"

endif
```

## breadkitchen/config/boards/shields/breadkitchen/Kconfig.shield
```kconfig
config SHIELD_BREADKITCHEN
       def_bool $(shields_list_contains,breadkitchen)
```
